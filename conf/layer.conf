## conf/layer.conf
```bitbake
# We have a conf and classes directory, add to BBPATH
BBPATH =. "${LAYERDIR}:"

# We have recipes-* directories, add to BBFILES
BBFILES += "${LAYERDIR}/recipes-*/*/*.bb \
            ${LAYERDIR}/recipes-*/*/*.bbappend"

BBFILE_COLLECTIONS += "immineo"
BBFILE_PATTERN_immineo = "^${LAYERDIR}/"
BBFILE_PRIORITY_immineo = "20"

LAYERSERIES_COMPAT_immineo = "kirkstone"

# This should only be incremented on significant changes that will
# cause compatibility issues with other layers
LAYERVERSION_immineo = "1"

REQUIRED_POKY_BBLAYERS_CONF_VERSION = "2"
```
